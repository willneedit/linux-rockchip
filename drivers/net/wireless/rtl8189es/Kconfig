## drivers/net/wireless/rtl8189es/Kconfig
```kconfig
config RTL8189ES
	tristate "Realtek 8189ES SDIO WiFi Support"
    select WIRELESS_EXT
    select WEXT_PRIV
    select IEEE80211
	---help---
	  Help message of RTL8189ES
```
